## components/robusto/misc/src/umts/Kconfig
```kconfig
menu "UMTS gateway"
config ROBUSTO_UMTS_SERVER
        bool "Include the UMTS gateway"
        help
            Set this option to tell Robusto to load the UMTS gateway.
            The UMTS gateway allows access to the cellular network and presents two services:
            1. Sending MQTT messages to a predefined server
            2. Sending SMS messages to a specified recipient

    menu "UMTS gateway configuration"
        depends on ROBUSTO_UMTS_SERVER
        choice ROBUSTO_UMTS_MODEM_DEVICE
            depends on ROBUSTO_UMTS_SERIAL_CONFIG_UART
            prompt "Choose supported modem device (DCE)"
            default ROBUSTO_UMTS_MODEM_DEVICE_BG96
            help
                Select modem device connected to the ESP DTE.
            config ROBUSTO_UMTS_MODEM_DEVICE_SIM800
                bool "SIM800"
                help
                    SIMCom SIM800L is a GSM/GPRS module.
                    It supports Quad-band 850/900/1800/1900MHz.
            config ROBUSTO_UMTS_MODEM_DEVICE_BG96
                bool "BG96"
                help
                    Quectel BG96 is a series of LTE Cat M1/Cat NB1/EGPRS module.
            config ROBUSTO_UMTS_MODEM_DEVICE_SIM7000
                bool "SIM7000"
                help
                    SIM7000 is Multi-Band LTE CAT-M1、 LTE CAT-NB1、GPRS and EDGE module    
            config ROBUSTO_UMTS_MODEM_DEVICE_SIM7600
                bool "SIM7600"
                help
                    SIM7600 is Multi-Band LTE-TDD/LTE-FDD/HSPA+ and GSM/GPRS/EDGE module

            
        endchoice
        choice ROBUSTO_UMTS_SERIAL_CONFIG
            prompt "Type of serial connection to the modem"
            default ROBUSTO_UMTS_SERIAL_CONFIG_UART
            config ROBUSTO_UMTS_SERIAL_CONFIG_UART
                bool "UART"
                help
                    Connect to modem via UART.
            config ROBUSTO_UMTS_SERIAL_CONFIG_USB
                bool "USB"
                depends on IDF_TARGET_ESP32S2 || IDF_TARGET_ESP32S3
                help
                    Connect to modem via USB (CDC-ACM class). For IDF version >= 4.4.
                    TODO: Check if this config need updating
        endchoice 
        menu "UART Configuration"
            depends on ROBUSTO_UMTS_SERIAL_CONFIG_UART
            config ROBUSTO_UMTS_MODEM_UART_TX_PIN
                int "TXD Pin Number"
                default 27
                range 0 31
                help
                    Pin number of UART TX.

            config ROBUSTO_UMTS_MODEM_UART_RX_PIN
                int "RXD Pin Number"
                default 26
                range 0 31
                help
                    Pin number of UART RX.

            config ROBUSTO_UMTS_MODEM_UART_RTS_PIN
                int "RTS Pin Number"
                default -1 # TODO: We need to handle the unused settings better
                range -1 31
                help
                    Pin number of UART RTS. Not used on som

            config ROBUSTO_UMTS_MODEM_UART_CTS_PIN
                int "CTS Pin Number"
                default 23
                range 0 31
                help
                    Pin number of UART CTS.

            config ROBUSTO_UMTS_MODEM_UART_EVENT_TASK_STACK_SIZE
                int "UART Event Task Stack Size"
                range 2000 6000
                default 2048
                help
                    Stack size of UART event task.

            config ROBUSTO_UMTS_MODEM_UART_EVENT_TASK_PRIORITY
                int "UART Event Task Priority"
                range 3 22
                default 5
                help
                    Priority of UART event task.

            config ROBUSTO_UMTS_MODEM_UART_EVENT_QUEUE_SIZE
                int "UART Event Queue Size"
                range 10 40
                default 30
                help
                    Length of UART event queue.

            config ROBUSTO_UMTS_MODEM_UART_PATTERN_QUEUE_SIZE
                int "UART Pattern Queue Size"
                range 10 40
                default 20
                help
                    Length of UART pattern queue.

            config ROBUSTO_UMTS_MODEM_UART_TX_BUFFER_SIZE
                int "UART TX Buffer Size"
                range 256 2048
                default 512
                help
                    Buffer size of UART TX buffer.

            config ROBUSTO_UMTS_MODEM_UART_RX_BUFFER_SIZE
                int "UART RX Buffer Size"
                range 256 2048
                default 1024
                help
                    Buffer size of UART RX buffer.
        endmenu
        menu "PPP (internet) Configuration"
            config ROBUSTO_UMTS_MODEM_PPP_APN
                string "Set MODEM APN (required!)"
                default "THIS CANNOT BE EMPTY"
                help
                    Set APN (Access Point Name), a logical name to choose data network
                    Note that this has to have a valid value for most purposes.

            config ROBUSTO_UMTS_MODEM_PPP_AUTH_USERNAME
                string "Set username for authentication"
                default "espressif"
                depends on !ROBUSTO_UMTS_MODEM_PPP_AUTH_NONE
                help
                    Set username for PPP Authentication.

            config ROBUSTO_UMTS_MODEM_PPP_AUTH_PASSWORD
                string "Set password for authentication"
                default "esp32"
                depends on !ROBUSTO_UMTS_MODEM_PPP_AUTH_NONE
                help
                    Set password for PPP Authentication.

            config ROBUSTO_UMTS_MODEM_PPP_AUTH_NONE
                bool "Skip PPP authentication"
                default n
                help
                    Set to true for the PPP client to skip authentication

        endmenu
        config ROBUSTO_UMTS_NEED_SIM_PIN
            bool "SIM PIN needed"
            default n
            help
                Enable to set SIM PIN before starting the example

        config ROBUSTO_UMTS_SIM_PIN
            string "Set SIM PIN"
            default "1234"
            depends on ROBUSTO_UMTS_NEED_SIM_PIN
            help
                Pin to unlock the SIM

        config ROBUSTO_UMTS_MQTT_GATEWAY
            bool "Include the UMTS MQTT gateway"
            help
                Set this option to tell Robusto to load the UMTS MQTT gateway
        

            config ROBUSTO_UMTS_MQTT_GATEWAY_BROKER_URL
                depends on ROBUSTO_UMTS_MQTT_GATEWAY
                default "mqtt://test.mosquitto.org"
                string "The UMTS MQTT broker URL"
                help
                    This is the address of the MQTT broker       
        

        config ROBUSTO_UMTS_HTTP
            bool "Include the UMTS HTTP client"
            help
                Set this option to tell Robusto to load the UMTS HTTP client library.
        menu "OAuth2"
            depends on ROBUSTO_UMTS_HTTP
            config ROBUSTO_UMTS_HTTP_OAUTH_CLIENT_ID
                string "Oauth2 client_id"
                help
                    The Oauth2 client id. Supplied by for example the Google cloud API.
            config ROBUSTO_UMTS_HTTP_OAUTH_CLIENT_SECRET
                string "Oauth2 client_secret"
                help
                    The Oauth2 client secret. Supplied by for example the Google cloud API.
            config ROBUSTO_UMTS_HTTP_OAUTH_DEVICE_CODE_URL
                string "Oauth2 device code R"
                default "https://oauth2.googleapis.com/device/code"
                help
                    The Oauth2 authentication url for limited-input devices.
                    For example, it is "https://oauth2.googleapis.com/device/code" (default)
                    ..or https://login.microsoftonline.com/common/oauth2/v2.0/devicecode for private Microsoft accounts.
                    For AD accounts, "common" is replaced by the tenant. 
            config ROBUSTO_UMTS_HTTP_OAUTH_ACCESS_TOKEN_URL
                string "Oauth2 access token request URL"
                default "https://oauth2.googleapis.com/token"
                help
                    The Oauth2 access token request URL for limited-input devices.
                    For example, it is "https://oauth2.googleapis.com/device/code" (default)
                    ..or https://login.microsoftonline.com/common/oauth2/v2.0/token for private Microsoft accounts.
                    For AD accounts, "common" is replaced by the tenant. 
        
            config ROBUSTO_UMTS_HTTP_OAUTH_SCOPES
                string "Oauth2 scopes"
                default "https%3A%2F%2Fwww.googleapis.com%2Fauth%2Fdrive.file"
                help
                    A space-separate and URL encoded*  list of scopes. Files.ReadWrite
                    For example, it is "https://www.googleapis.com/auth/drive" (default)
                    ..or "Files.ReadWrite" for OneDrive.

                    * important, try https://www.urlencoder.org/

        endmenu
        

    endmenu
    config ROBUSTO_UMTS_CLIENT
        bool "Include the UMTS client"
        help
            Set this option to tell Robusto to load the UMTS client library.
endmenu
```
