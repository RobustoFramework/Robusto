## components/robusto/network/Kconfig
```kconfig
menu "Networking"
	config ROBUSTO_SUPPORTS_BLE
		bool "Load Bluetooth Low Energy (BLE) libraries"
        select BT_ENABLED
		help
            Set this option to tell Robusto to load the Bluetooth library.
            Automatically enable Bluetooth, but the NimBLE has to be selected manually under Bluetooth settings.
            https://en.wikipedia.org/wiki/Bluetooth_Low_Energy

	orsource "src/media/ble/Kconfig"

	config ROBUSTO_SUPPORTS_ESP_NOW
		bool "Load ESP-Now libraries"
		help
			Set this option to tell Robusto to load the ESP-Now library
			https://www.espressif.com/en/products/software/esp-now/overview

	orsource "src/media/espnow/Kconfig"

	config ROBUSTO_SUPPORTS_LORA
		bool "Load LoRa libraries"
		help
			Set this option to tell Robusto to load the LoRa library
			https://en.wikipedia.org/wiki/LoRa
	
	orsource "src/media/lora/Kconfig"   

	config ROBUSTO_SUPPORTS_CANBUS
		bool "Load CAN bus libraries"
		help
			Set this option to tell Robusto to load the CAN bus library
			https://en.wikipedia.org/wiki/CAN_bus
	
	orsource "src/media/canbus/Kconfig"             
		
	config ROBUSTO_SUPPORTS_I2C
		bool "Load I2C libraries"
		help
			Set this option to tell Robusto to load the I2C wired library
			https://en.wikipedia.org/wiki/I%C2%B2C
		
	orsource "src/media/i2c/Kconfig" 

	config ROBUSTO_PEER_NAME_LENGTH
		int "Peer name length"
		default 16
		help
			The length of the Robusto peer name. 

	config ROBUSTO_PEER_NAME
		string "The name of the peer"
		default "UNNAMEDPEER"
		help
			The name of the peer 
	config ROBUSTO_PEER_HEARTBEAT_SKIP_COUNT
		int "Heartbeat frequency (in skipped repeater ticks)"
		default 50
		help
			This is how often each peer and media will be sent heartbeats.
    config ROBUSTO_PEER_HEARTBEAT_PROBLEM_SKIP_COUNT
        int "Heartbeat frequency when there are problems (in skipped repeater ticks)"
        default 100
        help
            This is how often each peer and media will be sent heartbeats when a peer has problems.
	config ROB_RECEIPT_TIMEOUT_MS
		int "How many milliseconds will Robusto wait for a receipt?"
		default 100
		help
			When working synchronously an not broadcasting, Robusto will wait for a short while until it gets a receipt from the receiver, saying that the CRC matched. 
			This indicates that the message was transmitted properly, and can then be reported back to the sending app, if needed.
			Usually, this is a quite the short time, as the receipt is just a few bytes and the receiver is supposed to do this immidiately, 
			but networking congestion or other things man cause the receiver to have to wait a little.
	   
	menu "XPowersLib Configuration"
		depends on  IDF_TARGET_ESP32
		
		choice PMU_Type
			prompt "XPowers chip type"
			default XPOWERS_CHIP_AXP2102 if IDF_TARGET_ESP32
			default XPOWERS_CHIP_AXP192
			help
				Defines the default peripheral for xpowers example
	
			config XPOWERS_CHIP_AXP2102
				bool "Xpowers AXP2101"
			config XPOWERS_CHIP_AXP192
				bool "Xpowers AXP192"
		endchoice
	
		config I2C_MASTER_PORT_NUM
			int "PMU I2C Port Number"
			default 1
			help
				Port number for I2C Master device.
	
		config I2C_MASTER_FREQUENCY
			int "Master Frequency"
			default 100000
			help
				I2C Speed of Master device.
	
		config PMU_I2C_SCL
			int "PMU SCL GPIO Num"
			default 22
			help
				GPIO number for I2C PMU clock line.
	
		config PMU_I2C_SDA
			int "PMU SDA GPIO Num"
			default 21
			help
				GPIO number for I2C PMU data line.
	
		config PMU_INTERRUPT_PIN
			int "PMU Interrupt Pin"
			default 35
			help
				PMU interrupt pin.
	
	
	endmenu 
	menu "Testing & simulation"
        config ROBUSTO_NETWORK_MOCK_TESTING
            bool "Add a mock media type and run mock tests"
            help
                This causes the library to add a mock media type. These mocks mimics generic behaviours, 
                making it possible to test non-media specific messaging code in an at least slightly realistic manner.
                This is most useful when running the tests on a PC. Because of its speed, this makes tests run much faster.
                
        config ROBUSTO_NETWORK_INTEGRATION_TESTING
            bool "Show integration testing settings"
            help
                This shows settings for running tests where Robusto peer actually calls each other and tests.
        config ROBUSTO_NETWORK_QOS_TESTING
            bool "Run in QoS testing mode"
            help
                This causes the library to run in QoS testing mode. 
                It makes various settings that simulates disturbances available.
                The mode is used to test Robustos ability to handle problematic situations, 
                like glitching cables, radio interference or jamming (the bad kind).
                This breaks unit- and integration testing as it changes the behaviour of the system, and thus cannot be combined. 
        if ROBUSTO_NETWORK_INTEGRATION_TESTING && ROBUSTO_NETWORK_QOS_TESTING
            comment "WARNING!! You should not have both integration testing and QoS testing enabled at the same time. WARNING!!"
        endif
		menu "QoS testing"
			depends on ROBUSTO_NETWORK_QOS_TESTING
			config ROBUSTO_NETWORK_QOS_INITIATOR 
				bool "This module will initiate QOS testing"
				help
					If set, this module will be the one initiating QoS testing. 
					
					If now set, it will wait until being contacted, and. 
					It will use the test settings under each available media (for example mac address or i2c address).
					
					

		endmenu
        config ROBUSTO_TESTING_SKIP_NTH_FRAGMENT
            int "Fragment to skip in testing"
            depends on ROBUSTO_NETWORK_INTEGRATION_TESTING
            default 2
            help
                This causes the mentioned fragment to be skipped in testing to test resending fragments.
                -1 means no fragments are skipped.

        config ROBUSTO_TESTING_FRAGMENT_MESSAGE_SIZE
            int "Fragment size in testing"
            depends on ROBUSTO_NETWORK_INTEGRATION_TESTING
            default 20000
            help
                The size in kb of the fragments tested (also used for the number of milliseconds until the tests timeout for ESP-NOW).
                Note that they need to match on sender and receiver.
        
        choice ROBUSTO_NETWORK_TEST_SELECT_INITIAL_MEDIA
            bool "The media to start testing with"
            help
                Which media should we start testing with?
            config ROBUSTO_NETWORK_TEST_SELECT_INITIAL_MEDIA_I2C
                bool "I2C"
                depends on ROBUSTO_SUPPORTS_I2C
                help
                    Start testing with I2C.
                    
            config ROBUSTO_NETWORK_TEST_SELECT_INITIAL_MEDIA_ESP_NOW
                bool "ESP-NOW"
                depends on ROBUSTO_SUPPORTS_ESP_NOW
                help
                    Start testing with ESP-NOW.
            
            config ROBUSTO_NETWORK_TEST_SELECT_INITIAL_MEDIA_LORA
                bool "LORA"
                depends on ROBUSTO_SUPPORTS_LORA
                help
                    Start testing with LoRa.
            config ROBUSTO_NETWORK_TEST_SELECT_INITIAL_MEDIA_BLE
                bool "BLE"
                depends on ROBUSTO_SUPPORTS_BLE
                help
                    Start testing with BLE.
            config ROBUSTO_NETWORK_TEST_SELECT_INITIAL_MEDIA_UMTS
                bool "UMTS"
                depends on ROBUSTO_SUPPORTS_UMTS
                help
                    Start testing with UMTS.
        endchoice
    endmenu
endmenu
```

## components/robusto/network/src/media/ble/Kconfig
```kconfig
menu "BLE-configuration - Do not forget to select the NimBLE host type in the configuration"
    depends on ROBUSTO_SUPPORTS_BLE

	menu "Testing"
		config ROB_NETWORK_TEST_BLE_LOOP_INITIATOR
			bool "This device begins and ends a test loop"
			depends on ROBUSTO_NETWORK_INTEGRATION_TESTING  
			help
				When testing the communication of several devices, a test loop is often constructed to test both sending and receiving of the same communication.

				The loop starts with all devices except from the initiator starts listening. 
				The first call is done by the initiator, that sends to the next and then starts listening. 
				The next, in turn sends to the next. 
				The last device have the initiator as the destination, and the loop is closed when the initiator has gotten the message. 


		config ROB_NETWORK_TEST_BLE_CALL_ADDR
			depends on ROBUSTO_NETWORK_INTEGRATION_TESTING || ROBUSTO_NETWORK_QOS_TESTING || ROBUSTO_EXAMPLE_HELLO_CLIENT || ROBUSTO_EXAMPLE_CONDUCTOR_CLIENT
            hex "The MAC-address of the BLE-enabled peer to test, a 6-byte hex value."
			default 0xFFFFFFFFFFFF
			range 0x000000000000 0xFFFFFFFFFFFF
			help
				When doing physical testing of BLE peers, this is the address this peer will call upon when testing.
				Write it as a large number, for example 0x01AB11BB12BC (6*8 bits)

        config ROB_NETWORK_TEST_BLE_KILL_SWITCH
            int "Kill switch GPIO - Makes BLE stop working when low"
            default -1
            help
                Used for testing scoring.

	endmenu      

    
endmenu
```

## components/robusto/network/src/media/canbus/Kconfig
```kconfig
menu "CAN bus configuration"
    depends on ROBUSTO_SUPPORTS_CANBUS
    
    config ROBUSTO_CANBUS_TX_IO
        int "TX GPIO Pin"
        default 4
        range 0 60
        help
            Pin number of the TX line.
    config ROBUSTO_CANBUS_RX_IO
        int "RX GPIO Pin"
        default 22
        range 0 60
        help
            Pin number of the RX (clock) line.

    config ROBUSTO_CANBUS_ADDRESS
        int "CAN bus address"
        default -1
        range -1 256
        help
            This is the 
            
    choice  ROBUSTO_CANBUS_BIT_RATE  
        prompt "Bit rate - the speed of the bus"
        config ROBUSTO_CANBUS_BIT_RATE_1MBITS
            bool "1 Mbit/s"
        config ROBUSTO_CANBUS_BIT_RATE_800KBITS     
            bool "800 Kbit/s"
        config ROBUSTO_CANBUS_BIT_RATE_500KBITS
            bool "500 Kbit/s"
        config ROBUSTO_CANBUS_BIT_RATE_250KBITS
            bool "250 Kbit/s"
        config ROBUSTO_CANBUS_BIT_RATE_125KBITS
            bool "125 Kbit/s"
        config ROBUSTO_CANBUS_BIT_RATE_100KBITS
            bool "100 Kbit/s"
        config ROBUSTO_CANBUS_BIT_RATE_50KBITS
            bool "50 Kbit/s"
        config ROBUSTO_CANBUS_BIT_RATE_25KBITS
            bool "25 Kbit/s"
    if 0
        config ROBUSTO_CANBUS_BIT_RATE_20KBITS
            bool "20 Kbit/s"
        config ROBUSTO_CANBUS_BIT_RATE_16KBITS
            bool "16 Kbit/s"
        config ROBUSTO_CANBUS_BIT_RATE_12_5KBITS
            bool "12.5 Kbit/s"
    endif
    endchoice
    config CANBUS_ACKNOWLEGMENT_TIMEOUT_MS
        int "CAN busacknowlegement timeout (milliseconds)"
        default 50
        range 0 10000
        help
            The extra time Robusto will wait for a acknowledgement (not to confuse with CAN busack/nack).
            To minimize the time it hogs the line to optimize throughput, Robusto
            predict the time a transmission will take and adjust timeouts to this. 
            However, it has to wait a short while for the slave to respond with the receipt. 
            This it usually a very short time, but if the slave has enabled heavy logging for example, 
            it might take hundreds of milliseconds. Here this can be taken into account.

    config SDP_SIM_CANBUS_BAD_CRC
        int "| SIM | The number of times CAN bus will get a bad CRC32 on all requests"
        default 0
        depends on SDP_SIM   
        range 0 256
        help
            When a peer returns with a CRC32 on the message, this will intervene and set the wrong
            value, causing all crc checks to fail SDP_SIM_CANBUS_BAD_CRC number of times.
    menu "Testing"
        
            config ROB_NETWORK_TEST_CANBUS_LOOP_INITIATOR
            bool "This device begins and ends a test loop"
            depends on ROBUSTO_NETWORK_INTEGRATION_TESTING            
            help
                When testing the communication of several devices, a test loop is often constructed to test both sending and receiving of the same communication.

                The loop starts with all devices except from the initiator starts listening. 
                The first call is done by the initiator, that sends to the next and then starts listening. 
                The next, in turn sends to the next. 
                The last device have the initiator as the destination, and the loop is closed when the initiator has gotten the message. 

        config ROB_NETWORK_TEST_CANBUS_CALL_ADDR
            depends on ROBUSTO_NETWORK_INTEGRATION_TESTING || ROBUSTO_NETWORK_QOS_TESTING || ROBUSTO_EXAMPLE_HELLO_CLIENT || ROBUSTO_EXAMPLE_CONDUCTOR_CLIENT
            int "The CAN busaddress to test"
            default -1
            help
                When doing physical testing of CAN busnetworks, this is the address one will call upon when testing


        config ROB_NETWORK_TEST_CANBUS_KILL_SWITCH
            int "Kill switch GPIO - Makes CAN bus stop working when set low"
            default -1
            help
                Used for testing scoring.
        
    endmenu  

endmenu
```
