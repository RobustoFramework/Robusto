## components/robusto/proxy/Kconfig
```kconfig
menu "Robusto Proxy"

    config ROBUSTO_PROXY
        bool "Enable Robusto proxy"
        default n

    choice ROBUSTO_PROXY_ROLE
        prompt "Proxy role"
        depends on ROBUSTO_PROXY

        config ROBUSTO_PROXY_CLIENT
            bool "Delegating controller/client"

        config ROBUSTO_PROXY_SERVER
            bool "Delegated instance/server"

    endchoice

    config ROBUSTO_PROXY_SERVICE_PUBSUB
        bool "Enable PubSub delegation"
        depends on ROBUSTO_PROXY
        depends on ROBUSTO_PROXY_CLIENT || ROBUSTO_PUBSUB_SERVER
        default y

    choice ROBUSTO_PROXY_PROFILE
        prompt "Resource profile"
        depends on ROBUSTO_PROXY

        config ROBUSTO_PROXY_PROFILE_LOW_MEMORY
            bool "Low memory"

        config ROBUSTO_PROXY_PROFILE_STANDARD
            bool "Standard (not implemented for ESP SDIO)"
            help
                The portable standard profile is defined and native-tested,
                but the ESP32-P4/ESP32-C6 SDIO runtime currently allocates only
                the low-memory profile capacities. Selecting this profile for
                either ESP SDIO target stops configuration with an error.

    endchoice

    orsource "transports/esp_sdio/Kconfig"

endmenu
```

## components/robusto/server/Kconfig
```kconfig
menu "Repeater"
	config ROBUSTO_MAX_RECURRENCES
		int "Allocate memory for this many recurrence structs"
		default 10
		help
			Recurrances are registered in an array that is pre-sized. 
			To save memory or accomodate more recurrences, this value can be changed.
	config ROBUSTO_REPEATER_DELAY_MS
		int "The base sample delay for repeating in milliseconds"
		default 100
		help
			This setting controls how often the base repeater system repeat.
			A recurrence may execute at multiples of this frequency by providing 
			the number of recurrences to skip.	

endmenu
menu "Memory"
	config ROBUSTO_MONITOR_MEMORY
		bool "Do memory monitoring"
		default true
		help
			Enables or disables memory monitoring
	config ROBUSTO_MONITOR_MEMORY_SKIP_COUNT
		depends on ROBUSTO_MONITOR_MEMORY
		int "How often do we check the memory (skip count * ROBUSTO_REPEATER_DELAY_MS)"
		default 50
		help
			Memory will be measured every base sample if this is zero.
			Default is 50 (default base sample delay * 50 ~ 5 seconds) 
    config ROBUSTO_MONITOR_DANGER_USAGE
        depends on ROBUSTO_MONITOR_MEMORY
        int "Danger level usage"
        default 120000
        help
            Sets the level when memory usage gets dangerously high. 
            TODO: This should be reported, then trigger a reboot. Or perhaps trying to lower the runlevel first.
    config ROBUSTO_MONITOR_WARNING_USAGE
        depends on ROBUSTO_MONITOR_MEMORY
        int "Warning level usage"
        default 80000
        help
            Sets the level when Robusto starts warning about unusually high memory usage.
            Note that these levels may be in the gigabytes on native platforms.
            Here's 32 gigabytes for your copy & paste convenience: 32000000000.
            TODO: Reaching the warning level should be reported, of course.
            
        
            
endmenu	
```

## components/robusto/ui/Kconfig
```kconfig
menu "UI"
	config ROBUSTO_UI
		bool "UI"
    if ROBUSTO_UI

        config ROBUSTO_UI_BANNER
            string "Startup banner"
            default "-=ROBUSTO=-"
            help
                The text that appears.
        choice ROBUSTO_UI_LVGL_LCD_CONTROLLER
            bool "Display controller"
            default ROBUSTO_UI_LVGL_LCD_CONTROLLER_SSD1306
            help
                Choose a display controller
            config ROBUSTO_UI_LVGL_LCD_CONTROLLER_SSD1306
                bool "SSD1306"
            config ROBUSTO_UI_LVGL_LCD_CONTROLLER_SH1106
                bool "SH1106"
            config ROBUSTO_UI_LVGL_LCD_CONTROLLER_SH1107
                bool "SH1107"
        endchoice
        choice ROBUSTO_UI_LVGL_ROTATION
            bool "Rotation"
            default ROBUSTO_UI_LVGL_ROTATION_NONE
            help
                Choose a display controller
            config ROBUSTO_UI_LVGL_ROTATION_NONE
                bool "No rotation"
            config ROBUSTO_UI_LVGL_ROTATION_90
                bool "Rotate 90 degrees"
            config ROBUSTO_UI_LVGL_ROTATION_180
                bool "Rotate 180 degrees"
            config ROBUSTO_UI_LVGL_ROTATION_270
                bool "Rotate 270 degrees"
        endchoice

        config ROBUSTO_UI_LCD_H_RES
            int "Horizontal resolution"
            default 128
        config ROBUSTO_UI_LCD_V_RES
            int "Vertical resolution"
            default 64
    
        config ROBUSTO_UI_I2C_PORT
            int "Minimal UI I2C port"
            default 1

            help
                The I2C reset GPIO of the screen
        config ROBUSTO_UI_GPIO_RST
            int "Minimal UI SDA Reset GPIO"
            default -1
            help
                The I2C reset GPIO of the screen
        config ROBUSTO_UI_I2C_HW_ADDR
            hex "I2C address of screen"
            default 0x3c
        config ROBUSTO_UI_INIT_I2C
            bool "Initialize I2C"
            help 
                Sometimes, other parts of the system may already have initiated the I2C port.
                So to not break functionality (and avoid errors here), we may want to avoid doing that.
            default true   
        if ROBUSTO_UI_INIT_I2C
            config ROBUSTO_UI_GPIO_SDA
                int "Minimal UI SDA GPIO"
                default 4
                help
                    The I2C SDA GPIO of the screen
            config ROBUSTO_UI_GPIO_SCL
                int "Minimal UI SCL GPIO"
                default 15
                help
                    The I2C SCL GPIO of the screen
            config ROBUSTO_UI_I2C_FREQ_HZ 
                int "Minimal UI I2C frequency"
                default 400000
                help
                    The I2C frequency of the screen

        endif
    endif
endmenu
```

## config_templates/Kconfig.RaspberryPi_Pico
```kconfig
orsource "components/**/Kconfig.projbuild"
orsource ".pio/libdeps/RaspberryPi_Pico/**/Kconfig.projbuild"
```

## config_templates/Kconfig.native
```kconfig
orsource "components/**/Kconfig.projbuild"
orsource ".pio/libdeps/Native/**/Kconfig.projbuild"
```

## config_templates/Kconfig.uno
```kconfig
orsource "components/robusto-base/Kconfig.projbuild"
orsource "components/robusto-limited/Kconfig.projbuild"
```

## defconfig
```kconfig
CONFIG_ROB_BLINK_GPIO=22
CONFIG_ROBUSTO_SUPPORTS_I2C=y
CONFIG_I2C_SCL_IO=5
CONFIG_I2C_ADDR=4
CONFIG_ROB_NETWORK_TEST_I2C_LOOP_INITIATOR=y
CONFIG_ROB_NETWORK_TEST_I2C_CALL_ADDR=2
CONFIG_ROBUSTO_PEER_NAME="PI_Pico"
CONFIG_ROBUSTO_NETWORK_INTEGRATION_TESTING=y
CONFIG_TEST_LIB_DEF=y
```

## examples/proxy/esp32_p4_c6_sdio/c6_delegate/sdkconfig.defaults
```kconfig
CONFIG_IDF_TARGET="esp32c6"
CONFIG_LOG_DEFAULT_LEVEL_INFO=y
CONFIG_ESPTOOLPY_FLASHSIZE_4MB=y
CONFIG_FREERTOS_HZ=1000
CONFIG_PARTITION_TABLE_CUSTOM=y
CONFIG_PARTITION_TABLE_CUSTOM_FILENAME="partitions.csv"

CONFIG_ROBUSTO_PEER_NAME="C6_DELEGATE"
CONFIG_ROBUSTO_PUBSUB_SERVER=y
CONFIG_ROBUSTO_PROXY=y
CONFIG_ROBUSTO_PROXY_SERVER=y
CONFIG_ROBUSTO_PROXY_SERVICE_PUBSUB=y
CONFIG_ROBUSTO_PROXY_PROFILE_LOW_MEMORY=y
```

## examples/proxy/esp32_p4_c6_sdio/p4_controller/sdkconfig.defaults
```kconfig
CONFIG_IDF_TARGET="esp32p4"
CONFIG_ESP32P4_SELECTS_REV_LESS_V3=y
CONFIG_ESP32P4_REV_MIN_100=y
CONFIG_LOG_DEFAULT_LEVEL_INFO=y
CONFIG_ESPTOOLPY_FLASHSIZE_32MB=y
CONFIG_FREERTOS_HZ=1000
CONFIG_PARTITION_TABLE_CUSTOM=y
CONFIG_PARTITION_TABLE_CUSTOM_FILENAME="partitions.csv"
CONFIG_SPIRAM=y
CONFIG_SPIRAM_MODE_HEX=y
CONFIG_SPIRAM_SPEED_200M=y
CONFIG_SPIRAM_USE_CAPS_ALLOC=y

CONFIG_ROBUSTO_PEER_NAME="P4_PROXY"
CONFIG_ROBUSTO_PROXY=y
CONFIG_ROBUSTO_PROXY_CLIENT=y
CONFIG_ROBUSTO_PROXY_SERVICE_PUBSUB=y
CONFIG_ROBUSTO_PROXY_PROFILE_LOW_MEMORY=y
```

## examples/proxy/esp32_p4_c6_sdio/provisioning/sdkconfig.defaults
```kconfig
CONFIG_IDF_TARGET="esp32p4"
CONFIG_ESP32P4_SELECTS_REV_LESS_V3=y
CONFIG_ESP32P4_REV_MIN_100=y
CONFIG_LOG_DEFAULT_LEVEL_INFO=y
CONFIG_ESPTOOLPY_FLASHSIZE_32MB=y
CONFIG_FREERTOS_HZ=1000
CONFIG_PARTITION_TABLE_CUSTOM=y
CONFIG_PARTITION_TABLE_CUSTOM_FILENAME="partitions.csv"
CONFIG_SPIRAM=y
CONFIG_SPIRAM_MODE_HEX=y
CONFIG_SPIRAM_SPEED_200M=y
CONFIG_SPIRAM_USE_CAPS_ALLOC=y

CONFIG_ESP_WIFI_REMOTE_ENABLED=y
CONFIG_ESP_WIFI_REMOTE_LIBRARY_HOSTED=y
CONFIG_SLAVE_IDF_TARGET_ESP32C6=y
CONFIG_ESP_HOSTED_SDIO_HOST_INTERFACE=y
CONFIG_ESP_HOSTED_P4_DEV_BOARD_NONE=y
CONFIG_ESP_HOSTED_SDIO_SLOT_1=y
CONFIG_ESP_HOSTED_SDIO_1_BIT_BUS=y
CONFIG_ESP_HOSTED_SDIO_BUS_WIDTH=1
CONFIG_ESP_HOSTED_SDIO_CLOCK_FREQ_KHZ=10000
CONFIG_ESP_HOSTED_PRIV_SDIO_PIN_CLK_SLOT_1=18
CONFIG_ESP_HOSTED_PRIV_SDIO_PIN_CMD_SLOT_1=19
CONFIG_ESP_HOSTED_PRIV_SDIO_PIN_D0_SLOT_1=14
CONFIG_ESP_HOSTED_PRIV_SDIO_PIN_D1_1BIT_BUS_SLOT_1=15
CONFIG_ESP_HOSTED_SDIO_RESET_ACTIVE_HIGH=y
CONFIG_ESP_HOSTED_SDIO_GPIO_RESET_SLAVE=54
CONFIG_ESP_HOSTED_SDIO_RESET_DELAY_MS=1500
CONFIG_ESP_HOSTED_SLAVE_RESET_ON_EVERY_HOST_BOOTUP=y

CONFIG_ROBUSTO_PEER_NAME="P4_PROVISIONER"
CONFIG_ROBUSTO_PROXY=y
CONFIG_ROBUSTO_PROXY_CLIENT=y
CONFIG_ROBUSTO_PROXY_PROFILE_LOW_MEMORY=y
```

## examples/src/Kconfig.projbuild
```kconfig
menu "Robusto Examples"
    config ROBUSTO_EXAMPLE_HELLO_SERVER
        bool "Server with hello service"
        default false
        help
            A normal server setup with an example hello service registered. 
            Code is located under examples/hello.

    config ROBUSTO_EXAMPLE_HELLO_CLIENT
        bool "The hello client"
        default false

        help
            This is the client of the server, it means that it is will contact the server.
            To configure the way to connect, look at the networking testing settings.

    config ROBUSTO_EXAMPLE_INPUT_LADDER
        bool "The resistor ladder button example"
        default false
        help
            See the README.md in the source for more information.

        
    config ROBUSTO_EXAMPLE_HELLO_UI
        bool "Run the hello ui"

    config ROBUSTO_EXAMPLE_CONDUCTOR_CLIENT
        bool "The conductor client example"
        select ROBUSTO_CONDUCTOR_CLIENT
        default false
        help
            This is the conductor client, it will contact the conductor and then fall asleep periodically and communicate with the conductor peer.
            To configure the way to connect, look at the networking testing settings.

    config ROBUSTO_EXAMPLE_CONDUCTOR_SERVER
        bool "The conductor server example"
        select ROBUSTO_CONDUCTOR_SERVER
        default false
        help
            This is the conductor server, it will:
            1. Wait for a client to connect for at least ROBUSTO_CONDUCTOR_SERVER_AWAKE_TIME_MS, at most twice that
            2. Tell it to sleep for a the time defined in ROBUSTO_CONDUCTOR_SERVER_CYCLE_TIME_MS
            3. Go to sleep for the same time
            4. Repeat

    config ROBUSTO_UMTS_EXAMPLE_SMS
        bool "The UMTS/SMS example"
        help 
            This sends an SMS to the recipient specified below.
            Note that the UMTS gateway has to be enabled and configured.

        config ROBUSTO_UMTS_EXAMPLE_SMS_NUMBER
            string "The recipient phone number"
            depends on ROBUSTO_UMTS_EXAMPLE_SMS

        config ROBUSTO_UMTS_EXAMPLE_SMS_MESSAGE
            string "The message to send"
            depends on ROBUSTO_UMTS_EXAMPLE_SMS

    config ROBUSTO_UMTS_EXAMPLE_MQTT
        bool "The UMTS/MQTT example"
        help 
            This sends an MQTT message the specified MQTT server
            The server is set in the MQTT server settings, and also the main path.
            Note that the UMTS gateway has to be enabled and configured.

        config ROBUSTO_UMTS_EXAMPLE_MQTT_TOPIC
            string "The MQTT topic to send the message to"
            depends on ROBUSTO_UMTS_EXAMPLE_MQTT
            default "/topic/robusto_example"

        config ROBUSTO_UMTS_EXAMPLE_MQTT_MESSAGE
            string "The message to send"
            depends on ROBUSTO_UMTS_EXAMPLE_MQTT
            default "Hello MQTT!"


    config ROBUSTO_UMTS_EXAMPLE_GOOGLE_DRIVE
        bool "The UMTS/OAuth2 and Google drive example"
        help 
            This posts a file to google drive

    config ROBUSTO_UMTS_EXAMPLE_NTP
        bool "The UMTS/NTP example"
        help 
            This syncs the time on the MCU with time from an ntp-server.
            Note that the UMTS gateway has to be enabled and configured.
    config ROBUSTO_CAMERA_EXAMPLE
        bool "The Camera example"
        help 
            This takes a picture and sends it using Robusto.
    
    rsource "../camera/Kconfig"

    config ROBUSTO_FLASH_EXAMPLE_SPIFFS
        bool "The flash SPIFF example"
        help 
            Enables the flash SPIFF example
       
endmenu

        
```
