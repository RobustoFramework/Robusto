## components/robusto-ui/Kconfig
```kconfig
menu "UI"
	config ROBUSTO_UI
		bool "UI"
        
    config ROBUSTO_UI_BANNER
		string "Startup banner"
        depends on ROBUSTO_UI
		default "-=ROBUSTO=-"
		help
			The text that appears.
    config ROBUSTO_UI_MINIMAL
        bool "Minimal UI support"
        depends on ROBUSTO_UI
        help
            Support a minimal UI (like SSD1306 etcetera)
    config ROBUSTO_UI_MINIMAL_GPIO_SDA
        int "Minimal UI SDA GPIO"
        default 4
        depends on ROBUSTO_UI_MINIMAL
        help
            The I2C SDA GPIO of the screen
    config ROBUSTO_UI_MINIMAL_GPIO_SCL
        int "Minimal UI SCL GPIO"
        default 15
        depends on ROBUSTO_UI_MINIMAL
        help
            The I2C SCL GPIO of the screen
    config ROBUSTO_UI_MINIMAL_GPIO_RST
        int "Minimal UI SDA Reset GPIO"
        default 16
        depends on ROBUSTO_UI_MINIMAL
        help
            The I2C reset GPIO of the screen
    config ROBUSTO_UI_MINIMAL_I2C_PORT
        int "Minimal UI I2C port"
        default 1
        depends on ROBUSTO_UI_MINIMAL
        help
            The I2C reset GPIO of the screen
    config ROBUSTO_UI_MINIMAL_I2C_FREQ_HZ 
        int "Minimal UI I2C frequency"
        depends on ROBUSTO_UI_MINIMAL
        default 400000
        help
            The I2C frequency of the screen
        config ROBUSTO_UI_MINIMAL_INTRO             
            bool "Show an intro on boot"
            depends on ROBUSTO_UI
            help
                Shows an animation on initialization
            
endmenu
```

## components/robusto/Kconfig.projbuild
```kconfig
# Kconfig file for Robusto v0.1.0
menu "Robusto Configuration"
    orsource "base/Kconfig"                   
    orsource "network/Kconfig"
    orsource "server/Kconfig"
    orsource "ui/Kconfig"
    orsource "conductor/Kconfig"
    orsource "flash/Kconfig"
    orsource "misc/src/pubsub/Kconfig"
    orsource "misc/src/umts/Kconfig"
    orsource "input/Kconfig"
endmenu
```

## components/robusto/base/Kconfig
```kconfig
# Kconfig file for Robusto v0.1.0

menu "Base system configuration"
    config ROBUSTO_SLEEP
        bool "Sleep functionality"  
        help
            The Robusto sleeping functionality.
            This is a setting as the sleep functionality uses some of the very scarce RTC memory.

    choice ROB_LOG_DEFAULT_LEVEL
        prompt "Default log level"
        default ROB_LOG_LEVEL_INFO
        help
            Select the maximum log level, nothing below this will be sent to output.
        config ROB_LOG_LEVEL_NONE
            bool "NONE"
            help
                No log output will be written.
                I will also change the logging to use empty dummy implementations for logging in general, minimizing memory usage. 
        config ROB_LOG_LEVEL_ERROR
            bool "ERROR"
            help
                Only write critical errors, that the system can not recover from.
        config ROB_LOG_LEVEL_WARN
            bool "WARN"
            help
                Report warnings, that something has gone wrong but has been handled, or might get worse.
        config ROB_LOG_LEVEL_INFO
            bool "INFO"
            help
                Write information messages which describe normal flow of events. 
        config ROB_LOG_LEVEL_DEBUG
            bool "DEBUG"
            help
                Write debugging information, useful when troubleshooting and debugging
        config ROB_LOG_LEVEL_VERBOSE
            bool "VERBOSE"
            help
                Even more detailed debugging information, often with memory dumps and large amounts of information. 
    endchoice                                        

    config ROB_LOG_MAXIMUM_LEVEL
        int
        default 0 if ROB_LOG_LEVEL_NONE
        default 1 if ROB_LOG_LEVEL_ERROR
        default 2 if ROB_LOG_LEVEL_WARN
        default 3 if ROB_LOG_LEVEL_INFO
        default 4 if ROB_LOG_LEVEL_DEBUG
        default 5 if ROB_LOG_LEVEL_VERBOSE

    config ROB_BLINK_GPIO
        int "GPIO of a blink LED"
        default -1
        help
            If > -1, the GPIO of a LED that can be used as an indicator.
    if IDF_TARGET_ESP32 || IDF_TARGET_ESP32S2 || IDF_TARGET_ESP32S3
    config ROBUSTO_HEAP_TRACING
        bool "Enable heap tracing"  
        help
            The Robusto sleeping functionality.
            This is a setting as the sleep functionality uses some of the very scarce RTC memory.
    endif
endmenu                    
```

## components/robusto/conductor/Kconfig
```kconfig
# Kconfig file for Robusto v0.1.0

menu "Conductor configuration"
    menuconfig ROBUSTO_CONDUCTOR_SERVER
        bool "Enable the conductor server"
        select ROBUSTO_SLEEP
        help
            This enables the conductor service, and causes the conductor to go into deep sleep when the wake time is over. 
            The conductor enables the network to save energy by timing the sleeping of peers.
        if ROBUSTO_CONDUCTOR_SERVER
            config ROBUSTO_CONDUCTOR_SERVER_CYCLE_TIME_S
                int "Sleep cycle length"
                default 3600
                help
                    Note that this is the time between wake ups, which must be a constant cycle.
                    It is not when it falls a sleep and how long, that depends on if it had to stay awake extra for some reason.
                    In seconds.

            config ROBUSTO_CONDUCTOR_SERVER_AWAKE_TIME_S
                int "Seconds awake if not extended" 
                default 40
                help 
                    This is how many seconds the server is awake if not asked to extend its time awake.
                    Note that ROBUSTO_CONDUCTOR_SERVER_MARGIN_S (default 4) is subtracted from this value. 
                    In seconds.

            config ROBUSTO_CONDUCTOR_SERVER_MARGIN_S
                int "Server margin, to have time to start up"
                default 4
                help
                    An MCU will need both a short time to shut down (turning stuff off, TODO: Is this here?), and booting up. 
                    This margin will be cause the MCU to wake from sleep mode earlier to have time to start up.
                    In seconds.
        endif
                
    menuconfig ROBUSTO_CONDUCTOR_CLIENT
        bool "Enable the conductor client"
        select ROBUSTO_SLEEP
        help
            The client contacts the conductor to get to know when it is next available
        if ROBUSTO_CONDUCTOR_CLIENT

            choice ROBUSTO_CONDUCTOR_CLIENT_CONDUCTOR_MEDIA
                prompt "Initial media for conductor"

                config ROBUSTO_CONDUCTOR_CLIENT_CONDUCTOR_MEDIA_BLE
                    depends on ROBUSTO_SUPPORTS_BLE
                    bool "BLE"
                config ROBUSTO_CONDUCTOR_CLIENT_CONDUCTOR_MEDIA_ESP_NOW
                    depends on ROBUSTO_SUPPORTS_ESP_NOW
                    bool "ESP-NOW"
                config ROBUSTO_CONDUCTOR_CLIENT_CONDUCTOR_MEDIA_LORA
                    depends on ROBUSTO_SUPPORTS_LORA
                    bool "LoRa"
                config ROBUSTO_CONDUCTOR_CLIENT_CONDUCTOR_MEDIA_UMTS
                    depends on ROBUSTO_SUPPORTS_UMTS
                    bool "UMTS"
                config ROBUSTO_CONDUCTOR_CLIENT_CONDUCTOR_MEDIA_I2C
                    depends on ROBUSTO_SUPPORTS_I2C
                    bool "I2C"
            endchoice

            config ROBUSTO_CONDUCTOR_CLIENT_CONDUCTOR_I2C_ADDRESS
                int "The I2C-address of the conductor"
                depends on ROBUSTO_CONDUCTOR_CLIENT_CONDUCTOR_MEDIA_I2C
                range 0 255
                help
                    This is the I2C address of the conductor.

            config ROBUSTO_CONDUCTOR_CLIENT_CONDUCTOR_MAC_ADDRESS
                hex "The MAC-address of the conductor, a 6-byte hex value"
                depends on !ROBUSTO_CONDUCTOR_CLIENT_CONDUCTOR_MEDIA_I2C
                range 0x000000000000 0xFFFFFFFFFFFF
                help
                    This is the MAC-address of the conductor
                    Write it as a large hexadecimal number, for example 0x01AB11BB12BC (6*8 bits)
        
            config ROBUSTO_CONDUCTOR_RETRY_WAIT_S
                int "Retry delay"
                default 30
                help
                    How long to wait before we try to reconnect to the conductor if 
                    we fail connecting. In seconds.
    
            config ROBUSTO_CONDUCTOR_AWAKE_MARGIN_MS
                int "Wake-up margin" 
                default 2
                depends on ROBUSTO_CONDUCTOR_CLIENT
                help
                    Wait a little extra to wake up to get into the queue when 
                    having many clients. In seconds.
        endif

endmenu                    
```

## components/robusto/flash/Kconfig
```kconfig
# Kconfig file for Robusto v0.1.0
menu "Flash"
    menuconfig ROBUSTO_FLASH
        bool "Enable the robusto flash library"
        help
            The flash library enabled reading and writing to flash memory (both external and internal).
        if ROBUSTO_FLASH
            config ROBUSTO_FLASH_SPIFFS
                bool "Mount a SPIFF path" 
                help 
                    On boot, mount the specified SPIFFS path in the VFS.

            config ROBUSTO_FLASH_SPIFFS_PATH
                depends on ROBUSTO_FLASH_SPIFFS
                string "The SPIFFS path to mount" 
                default "/spiffs"
                help 
                    The path to mount in the VFS            
        endif                    

endmenu                    
```

## components/robusto/input/Kconfig
```kconfig
menu "Input"

    config ROBUSTO_INPUT
		bool "Enables the robusto input service"
		default 0
		help
            The Robusto input service is responsible for handling and distributing information about inputs.
            Inputs are gpios, buttons, and similar.

    config ROBUSTO_INPUT_MOVEMENT_TOLERANCE
        int "The tolerance for voltage fluctuations in millivolts"
        depends on ROBUSTO_INPUT
        default 7   
    config ROBUSTO_INPUT_MINIMUM_VOLTAGE
        int "Minimum voltage in millivolts before considering it a short circuit or disconnect"
        depends on ROBUSTO_INPUT
        default 150



    config ROBUSTO_INPUT_ADC_MONITOR
		bool "Enable the Robusto ADC monitor and mapper"
		default 0
        depends on ROBUSTO_INPUT
		help
            Enables a tool that monitors a GPIO and prints out voltage and adc values in a resistance map format.

    config ROBUSTO_INPUT_ADC_MONITOR_GPIO
        int "Select GPIO to monitor"
        depends on ROBUSTO_INPUT_ADC_MONITOR
        range 0 50 

    config ROBUSTO_INPUT_ADC_MONITOR_RESISTOR_DIVIDER_R1
        int "The value of the R1 resistance in your voltage divider"
        depends on ROBUSTO_INPUT_ADC_MONITOR
        range 0 10000000
        default 41200
        help
            See recommendations in the Robusto docs for information on how
            you optimize resistance-based inputs (like binary ladders) for your ADC.

    config ROBUSTO_INPUT_ADC_MONITOR_RESISTOR_DIVIDER_V_IN
        int "The value of the Voltage in (Vin) to your voltage divider"
        depends on ROBUSTO_INPUT_ADC_MONITOR
        range 0 10000000
        default 3300
        help
            This is usually the voltage of the system, like 3v3 (3300, 3.3 volts) for an ESP32.
            Older MCUs, may be 5 volts (like the Arduino UNO). 
            Note that if you have issues with strange values, you might want to measure with a voltmeter to get the right values and tweak this a little. 

            
            
    config ROBUSTO_INPUT_ADC_MONITOR_RESISTOR_COUNT
        int "The number of resistances to monitor"
        depends on ROBUSTO_INPUT_ADC_MONITOR
        default 0

endmenu
```

## components/robusto/misc/Kconfig
```kconfig
menu "Publisher Subscriber"
	config ROBUSTO_PUBSUB_SERVER
		bool "Enable the Robusto Pub-Sub server"
		default false
		help
			Enable the Robusto Publisher-Subscriber server service.
    config ROBUSTO_PUBSUB_CLIENT
        bool "Enable the Robusto Pub-Sub client"
        default false
        help
            Enable the Robusto Publisher-Subscriber client service.
endmenu	
```
